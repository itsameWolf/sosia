## Kconfig.defconfig
```kconfig
if SHIELD_SOSIA_LEFT

config ZMK_KEYBOARD_NAME
	default "Sosia"

config ZMK_SPLIT_ROLE_CENTRAL
	default y

endif

if SHIELD_SOSIA_LEFT || SHIELD_SOSIA_RIGHT

config ZMK_SPLIT
	default y

endif
```

## Kconfig.shield
```kconfig
config SHIELD_SOSIA_LEFT
    def_bool $(shields_list_contains,sosia_left)

config SHIELD_SOSIA_RIGHT
    def_bool $(shields_list_contains,sosia_right)
```
